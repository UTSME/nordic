## CMakeLists.txt
```
cmake_minimum_required(VERSION 3.20.0)
find_package(Zephyr REQUIRED HINTS $ENV{ZEPHYR_BASE})

project(bluetooth_testing)

# NORDIC SDK APP START
target_sources(app PRIVATE src/main.c)
# NORDIC SDK APP END
zephyr_include_directories(src)

target_sources(app PRIVATE src/bluetooth_le_scanning.c)
target_sources(app PRIVATE src/bluetooth_le_discovery.c)
target_sources(app PRIVATE src/bluetooth_le_connection.c)
target_sources(app PRIVATE src/bluetooth_le_read_write.c)
```

## prj.conf
```kconfig
#
# Copyright (c) 2019 Nordic Semiconductor ASA
#
# SPDX-License-Identifier: LicenseRef-Nordic-5-Clause
#
# General config
CONFIG_ASSERT=y
CONFIG_REBOOT=y

# Network
CONFIG_NETWORKING=y
CONFIG_NET_NATIVE=n
CONFIG_NET_SOCKETS=y
CONFIG_NET_SOCKETS_OFFLOAD=y

# Logging
CONFIG_LOG=y

# Library for buttons and LEDs
CONFIG_DK_LIBRARY=y

# Console for user association
CONFIG_CONSOLE_SUBSYS=y
CONFIG_CONSOLE_GETCHAR=y

# Enable Bluetooth stack and libraries
CONFIG_BT=y
CONFIG_BT_H4=y
CONFIG_BT_WAIT_NOP=y
CONFIG_BT_CENTRAL=y
CONFIG_BT_GATT_CLIENT=y
CONFIG_BT_GATT_DM=y
CONFIG_BT_SCAN=y
CONFIG_BT_SCAN_FILTER_ENABLE=y
CONFIG_BT_SCAN_NAME_CNT=1

CONFIG_UART_INTERRUPT_DRIVEN=y

# Heap and stacks
CONFIG_HEAP_MEM_POOL_SIZE=16384
CONFIG_MAIN_STACK_SIZE=8192
CONFIG_SYSTEM_WORKQUEUE_STACK_SIZE=4096
```

## src/main.c
```c
#include "bluetooth_le_scanning.h"
#include "bluetooth_le_discovery.h"
#include "bluetooth_le_connection.h"
#include "bluetooth_le_read_write.h"

#include <zephyr/kernel.h>
#include <zephyr/logging/log.h>
#include <zephyr/bluetooth/uuid.h>

#define BT_UUID_TESTING_VAL \
        BT_UUID_128_ENCODE(0xbeb5483e, 0x36e1, 0x4688, 0xb7f5, 0xea07361b26a8)

#define BT_UUID_TESTING \
	BT_UUID_DECLARE_128(BT_UUID_TESTING_VAL)

const uint8_t esp32_name[] = "esp32_bt";
const uint8_t test_write_data[] = "12345678901122334455667788";
// const uint8_t test_write_data_2[] = "this is just numbers 1234567891011121314";

//Uses bluetooth as the logging name for logs produced by these functions
LOG_MODULE_REGISTER(main);

int main(void) {	
	bluetooth_le_add_attribute(BT_UUID_TESTING, BLUETOOTH_LE_ATTRIBUTE_INITIAL_HANDLE);

	bluetooth_le_setup();

	while (bt_is_ready() == false) {
		LOG_INF("Waiting for bluetooth...");
		k_msleep(2000);
	}

	bluetooth_le_start_scan(esp32_name);

	while (bluetooth_le_connection_get() == NULL) {
		LOG_INF("Waiting for bluetooth connection to start gatt service discovery...");
		k_msleep(2000);
	}

	bluetooth_le_gatt_print_services();

	k_msleep(4000);

	uint8_t test_arr[25];
	bluetooth_le_read_attribute(BT_UUID_TESTING, test_arr, 25);

	bluetooth_le_write_attribute(BT_UUID_TESTING, test_write_data, sizeof(test_write_data));

	bluetooth_le_read_attribute(BT_UUID_TESTING, test_arr, 25);

	//SOMETHING IS GOING WRONG WITH THE MUTEX THING FOR SOME REASON
	k_msleep(10000);
	for (int i = 0; i < 25; i++) {
		printk("%c", test_arr[i]);
	}

	k_msleep(4000);
	bluetooth_le_connection_disconnect();

	while(1) {
		LOG_PRINTK(".");
		k_msleep(2000);
	}
}
```

## src/bluetooth_le_connection.c
```c
#include "bluetooth_le_connection.h"
#include <zephyr/logging/log.h>

LOG_MODULE_REGISTER(bluetooth_le_connection);

static struct bt_conn *bluetooth_le_connection = NULL;

struct bt_conn* bluetooth_le_connection_get() {
    return bluetooth_le_connection;
}

void bluetooth_le_connection_set(struct bt_conn *bluetooth_le_connection_p) {
    bluetooth_le_connection = bluetooth_le_connection_p;
}

void bluetooth_le_connection_disconnect() {
    int err;

    if (bluetooth_le_connection == NULL) {
        LOG_ERR("Error disconnecting bluetooth connection, bluetooth is not currently connected");
        return;
    }

    err = bt_conn_disconnect(bluetooth_le_connection, BT_HCI_ERR_REMOTE_USER_TERM_CONN);
    if (err) {
        LOG_ERR("Error disconnecting bluetooth connection, error code: %d", err);
    }
    else {
        LOG_INF("Bluetooth connection successfully disconnected");
    }
}
```

## src/bluetooth_le_connection.h
```c
#ifndef BLUETOOTH_LE_CONNECTION_H
#define BLUETOOTH_LE_CONNECTION_H

#include <zephyr/bluetooth/bluetooth.h>
#include <zephyr/bluetooth/conn.h>
#include <zephyr/bluetooth/uuid.h>

//The pointer to the current bluetooth le connection, will be null if there is no connection established
// static struct bt_conn *bluetooth_le_connection;

//Returns a pointer to the currently established connection, will be null if there is no connection established
struct bt_conn* bluetooth_le_connection_get();

//Sets the pointer for the current connection
void bluetooth_le_connection_set(struct bt_conn *bluetooth_le_connection_p);

//Disconnects curernt bluetooth connection with reason: BT_HCI_ERR_REMOTE_USER_TERM_CONN
//https://docs.zephyrproject.org/latest/connectivity/bluetooth/api/connection_mgmt.html#c.bt_conn_disconnect
void bluetooth_le_connection_disconnect();



#endif
```

## src/bluetooth_le_discovery.c
```c
#include "bluetooth_le_discovery.h"
#include <zephyr/logging/log.h>

LOG_MODULE_REGISTER(bluetooth_le_discovery);

static uint8_t bluetooth_le_discover_callback(struct bt_conn *conn, const struct bt_gatt_attr *attr, struct bt_gatt_discover_params *params);

static struct bt_gatt_discover_params bluetooth_le_gatt_discover_paramaters = {.uuid = NULL,
																			   .func = &bluetooth_le_discover_callback,
																			   .start_handle = BT_ATT_FIRST_ATTRIBUTE_HANDLE,
																			   .end_handle = BT_ATT_LAST_ATTRIBUTE_HANDLE,
																			   .type = BT_GATT_DISCOVER_DESCRIPTOR};

static uint8_t bluetooth_le_discover_callback(struct bt_conn *conn, const struct bt_gatt_attr *attr, struct bt_gatt_discover_params *params) {
	printk("\n");
	if (attr == NULL) {
		LOG_INF("Discovery process finished");
		return BT_GATT_ITER_STOP;
	}
	else {
		LOG_INF("Found attribute");
		char UUID_buffer[UUID_PRINT_SIZE];
		bt_uuid_to_str(attr->uuid, UUID_buffer, sizeof(UUID_buffer));
		LOG_INF("UUID: %s", UUID_buffer);
		LOG_INF("Handle: %d", attr->handle);
	
		//Add the attribute to storage so it can be used to read and write later only if its been added earlier 
		if (bluetooth_le_get_attribute(attr->uuid).handle != BLUETOOTH_LE_ATTRIBUTE_INITIAL_HANDLE) {
			bluetooth_le_add_attribute(attr->uuid, attr->handle);
		}

		return BT_GATT_ITER_CONTINUE;
	}
}

void bluetooth_le_gatt_print_services() {
	int err;

	err = bt_gatt_discover(bluetooth_le_connection_get(), &bluetooth_le_gatt_discover_paramaters);
	if (err) {
		LOG_ERR("Error with starting discovery of gatt services, error code: %d", err);
	}
    else {
        LOG_INF("Gatt service discovery started");
    }
}
```

## src/bluetooth_le_discovery.h
```c
#ifndef BLUETOOTH_LE_DISCOVERY_H
#define BLUETOOTH_LE_DISCOVERY_H

#include "bluetooth_le_connection.h"
#include "bluetooth_le_read_write.h"

#include <zephyr/bluetooth/bluetooth.h>
#include <zephyr/bluetooth/gatt.h>
#include <zephyr/bluetooth/uuid.h>

//These are nrf header files
#include <bluetooth/gatt_dm.h>

//Size of a uuid in string form with the dashes
#define UUID_PRINT_SIZE 37

//Callback function when bt_gatt_read is called
// static uint8_t bluetooth_le_gatt_attribute_read_callback(struct bt_conn *conn, uint8_t err, struct bt_gatt_read_params *params, const void *data, uint16_t length);

//Callback function that is called when a service is discovered by bt_gatt_discover
// static uint8_t bluetooth_le_discover_callback(struct bt_conn *conn, const struct bt_gatt_attr *attr, struct bt_gatt_discover_params *params);

//Paramaters for reading from an attribute
// static struct bt_gatt_read_params bluetooth_le_gatt_read_paramaters = {.func = &bluetooth_le_gatt_attribute_read_callback,
// 																          .handle_count = 1};

//Paramaters for discovering attribute
// static struct bt_gatt_discover_params bluetooth_le_gatt_discover_paramaters = {.uuid = NULL,
// 																			      .func = &bluetooth_le_discover_callback,
// 																			      .start_handle = BT_ATT_FIRST_ATTRIBUTE_HANDLE,
// 																			      .end_handle = BT_ATT_LAST_ATTRIBUTE_HANDLE,
// 																			      .type = BT_GATT_DISCOVER_DESCRIPTOR};

// Starts the discovery of services
void bluetooth_le_gatt_print_services();

#endif
```

## src/bluetooth_le_read_write.c
```c
#include "bluetooth_le_read_write.h"
#include <zephyr/logging/log.h>

LOG_MODULE_REGISTER(bluetooth_le_read_write);

static uint8_t bluetooth_le_gatt_attribute_read_callback(struct bt_conn *conn, uint8_t err, struct bt_gatt_read_params *params, const void *data, uint16_t length);

static void bluetooth_le_gatt_attribute_write_callback(struct bt_conn *conn, uint8_t err, struct bt_gatt_write_params *params);

static struct bt_gatt_read_params bluetooth_le_gatt_read_paramaters = {.func = &bluetooth_le_gatt_attribute_read_callback,
																       .handle_count = 1,
                                                                       .single.offset = 0};

static struct bt_gatt_write_params bluetooth_le_gatt_write_paramaters = {.func = &bluetooth_le_gatt_attribute_write_callback};

static struct bluetooth_le_attributes bluetooth_le_attributes = {.capacity = BLUETOOTH_LE_ATTRIBUTE_CAPACITY,
                                                                 .size = 0}; 

static int r_w_in_progress = false;

static struct bluetooth_le_write_buffer {
    uint8_t *buffer;
    int buffer_length;
} bluetooth_le_write_buffer;

static uint8_t bluetooth_le_gatt_attribute_read_callback(struct bt_conn *conn, uint8_t err, struct bt_gatt_read_params *params, const void *data, uint16_t length) {
    printk("\n");
    if (data == NULL) {
        r_w_in_progress = false;
        bluetooth_le_gatt_read_paramaters.single.offset = 0;
        return BT_GATT_ITER_STOP;
    }

    LOG_INF("Reading from attribute...");

	if (err) {
		LOG_ERR("Error while reading from attribute, error code: %d", err);
	}

	LOG_INF("Data length: %d", length);

	if (length > 0) {
		char string[length + 1];
        memcpy(string, data, length);
        string[length] = '\0';
        LOG_INF("Data: %s", string);
        
        //Can read all bytes in at the correct offset
        if (bluetooth_le_write_buffer.buffer_length >= length + bluetooth_le_gatt_read_paramaters.single.offset) {
            memcpy(bluetooth_le_write_buffer.buffer + bluetooth_le_gatt_read_paramaters.single.offset, data, length);
            LOG_INF("Read %d out of %d bytes in to buffer", length, length);
        }
        /*
        EXAMPLE
        buffer len = 100
        offset = 92
        data size = 15
        */

        //Can only read in data len - data_size bytes
        else if (bluetooth_le_write_buffer.buffer_length > bluetooth_le_gatt_read_paramaters.single.offset) {
            int bytes_to_read = bluetooth_le_write_buffer.buffer_length - bluetooth_le_gatt_read_paramaters.single.offset;
            memcpy(bluetooth_le_write_buffer.buffer + bluetooth_le_gatt_read_paramaters.single.offset, data, bytes_to_read);
            LOG_INF("Read %d out of %d bytes in to buffer", bytes_to_read, length);
        }
        else {
            LOG_INF("Read 0 out of %d bytes into buffer", length);
        }
        
	}

    return BT_GATT_ITER_CONTINUE;
}

static void bluetooth_le_gatt_attribute_write_callback(struct bt_conn *conn, uint8_t err, struct bt_gatt_write_params *params) {
    printk("\n");
    if (err) {
        LOG_ERR("Error while writing to attribute, error code: %d", err);
    }
    else {
        LOG_INF("Wrote data to attribute");
    }
    r_w_in_progress = false;
}

int bluetooth_le_add_attribute(const struct bt_uuid *uuid_p, int handle_p) {
    if (bluetooth_le_attributes.size == bluetooth_le_attributes.capacity) {
        LOG_ERR("Attributes storage is full");
        return 1;
    }

    struct bluetooth_le_attribute temp_attribute = bluetooth_le_get_attribute(uuid_p);
    //Attribute is being added to storage for first time
    if (temp_attribute.handle == BLUETOOTH_LE_ATTRIBUTE_INITIAL_HANDLE) {
        bluetooth_le_attributes.attributes[bluetooth_le_attributes.size].uuid = uuid_p; 
        bluetooth_le_attributes.attributes[bluetooth_le_attributes.size].handle = BLUETOOTH_LE_ATTRIBUTE_ADDED_HANDLE; 
        bluetooth_le_attributes.attributes[bluetooth_le_attributes.size].index = bluetooth_le_attributes.size; 

        bluetooth_le_attributes.size++;
        LOG_INF("Added attribute to storage");
        return 0;
    }
    else {
        //The attribute is already in storage
        if (temp_attribute.handle == BLUETOOTH_LE_ATTRIBUTE_ADDED_HANDLE || temp_attribute.handle > 0) {
            LOG_INF("Attribute is already in storage, updating handle");
            bluetooth_le_attributes.attributes[temp_attribute.index].handle = handle_p;
            return 0;
        }
        //Attribute was not added using the bluetooth_le_add_attribute function initially with the handle_p as BLUETOOTH_LE_ATTRIBUTE_INITIAL_HANDLE
        else {
            LOG_ERR("Attribute was not initially added to storage");
            return 1;
        }
    }
}

struct bluetooth_le_attribute bluetooth_le_get_attribute(const struct bt_uuid *uuid_p) {
    char UUID_buffer[UUID_PRINT_SIZE];
    bt_uuid_to_str(uuid_p, UUID_buffer, UUID_PRINT_SIZE);
    LOG_INF("Looking for attribute with UUID: %s", UUID_buffer);
    for (int i = 0; i < bluetooth_le_attributes.size; i++) {
        if (bt_uuid_cmp(uuid_p, bluetooth_le_attributes.attributes[i].uuid) == 0)  {
            LOG_INF("Matching attribute found");
            return bluetooth_le_attributes.attributes[i];
        }
    }
    LOG_ERR("No matching attribute already in storage found");
    return (struct bluetooth_le_attribute) {.handle = BLUETOOTH_LE_ATTRIBUTE_INITIAL_HANDLE};
}

void bluetooth_le_read_attribute(const struct bt_uuid *uuid, uint8_t *buffer, int buffer_length) {
    printk("\n");

    while (r_w_in_progress == true) {
        LOG_INF("Waiting for mutex to be unlocked to start read...");
        k_msleep(1000);
    }
    r_w_in_progress = true;
    
    int err;

    const struct bluetooth_le_attribute attribute = bluetooth_le_get_attribute(uuid);

    if (attribute.handle <= 0) {
        LOG_ERR("Reading not started as their is no handle for this UUID");
        return;
    }

    if (buffer == NULL || buffer_length <= 0) {
        LOG_ERR("Error with provided buffer or buffer legnth");
        return;
    }
    else {
        bluetooth_le_write_buffer.buffer = buffer;
        bluetooth_le_write_buffer.buffer_length = buffer_length;
    }

    bluetooth_le_gatt_read_paramaters.single.handle = attribute.handle;

    err = bt_gatt_read(bluetooth_le_connection_get(), &bluetooth_le_gatt_read_paramaters);
    if (err) {
        LOG_ERR("Error starting attribute read, error code: %d", err);
    }
    else {
        LOG_INF("Started attribute read");
    }
}

//NEED TO ADD A MUTEX OR SEPHAMORE FOR THE READING AND WRITING SO IT DOESNT READ OR WRITE WHILE A READ OR WRITE IS ALREADY IN PROCESS
void bluetooth_le_write_attribute(const struct bt_uuid *uuid, const uint8_t *buffer, int buffer_length) {
    printk("\n");

    while (r_w_in_progress == true) {
        LOG_INF("Waiting for mutex to be unlocked to start write...");
        k_msleep(1000);
    }
    r_w_in_progress = true;

    int err;

    const struct bluetooth_le_attribute attribute = bluetooth_le_get_attribute(uuid);

    if (attribute.handle <= 0) {
        LOG_ERR("Writing not started as their is no handle for this UUID");
        return;
    }

    bluetooth_le_gatt_write_paramaters.handle = attribute.handle;
    bluetooth_le_gatt_write_paramaters.data = buffer;
    bluetooth_le_gatt_write_paramaters.length = buffer_length;

    err = bt_gatt_write(bluetooth_le_connection_get(), &bluetooth_le_gatt_write_paramaters);
    if (err) {
        LOG_ERR("Error starting attribute write, error code: %d", err);
    }
    else {
        LOG_INF("Started attribute write");
    }
}
```

## src/bluetooth_le_read_write.h
```c
#ifndef BLUETOOTH_LE_READ_WRITE_H
#define BLUETOOTH_LE_READ_WRITE_H

#include "bluetooth_le_connection.h"
#include "bluetooth_le_discovery.h"

#include <zephyr/bluetooth/bluetooth.h>
#include <zephyr/bluetooth/uuid.h>
#include <zephyr/bluetooth/gatt.h>

//Intial size for the amount of attributes that can be stored
#define BLUETOOTH_LE_ATTRIBUTE_CAPACITY 10

enum bluetooth_le_attribute_special_values {
    BLUETOOTH_LE_ATTRIBUTE_INITIAL_HANDLE = -1,
    BLUETOOTH_LE_ATTRIBUTE_ADDED_HANDLE = -2
};

//THIS WILL BE WORK AROUND TO USE UUID TO GET HANDLE WHICH THEN CAN BE USED IN READ SO BYTES AT THE END ARE NOT LOST
struct bluetooth_le_attribute {
    struct bt_uuid *uuid;
    int handle;
    int index;
};

struct bluetooth_le_attributes {
    struct bluetooth_le_attribute attributes[BLUETOOTH_LE_ATTRIBUTE_CAPACITY];
    int size;
    int capacity;
};

//Adds attribute to the struct of attributes that can be used to read and write.
//Will return 1 if the attributes struct is full, will return 0 on success
int bluetooth_le_add_attribute(const struct bt_uuid *uuid_p, int handle_p);

//Returns pointer to the attribute that matches the provided uuid
//If there is not such attribute in the bluetooth_le_attributes struct, it will return NULL
struct bluetooth_le_attribute bluetooth_le_get_attribute(const struct bt_uuid *uuid_p);

//Reads data into buffer and returns number of bytes read into it
void bluetooth_le_read_attribute(const struct bt_uuid *uuid, uint8_t *buffer, int buffer_length);

//Writes data from buffer to attribute specified by uuid
void bluetooth_le_write_attribute(const struct bt_uuid *uuid, const uint8_t *buffer, int buffer_length);

#endif
```

## src/bluetooth_le_scanning.c
```c
#include "bluetooth_le_scanning.h"
#include <zephyr/logging/log.h>

LOG_MODULE_REGISTER(bluetooth_le_scanning);

static void bluetooth_le_connected(struct bt_conn *conn, uint8_t conn_err);

// Paramaters taken from this example: https://developer.nordicsemi.com/nRF_Connect_SDK/doc/latest/nrf/samples/cellular/lte_ble_gateway/README.html
// https://developer.nordicsemi.com/nRF_Connect_SDK/doc/latest/zephyr/connectivity/bluetooth/api/gap.html#c.bt_le_scan_param
static struct bt_le_scan_param bluetooth_scan_paramaters = {.type = BT_LE_SCAN_TYPE_ACTIVE,
                                                     		.options = BT_LE_SCAN_OPT_FILTER_DUPLICATE,
                                                     		.interval = 0x0010,
                                                     		.window = 0x0010};

// Paramaters taken from this example: https://developer.nordicsemi.com/nRF_Connect_SDK/doc/latest/nrf/samples/cellular/lte_ble_gateway/README.html
// https://developer.nordicsemi.com/nRF_Connect_SDK/doc/latest/nrf/libraries/bluetooth_services/scan.html#c.bt_scan_init_param
static struct bt_scan_init_param bluetooth_initialisation_paramaters = {.connect_if_match = true,
																 		.scan_param = &bluetooth_scan_paramaters,
                                                                 		.conn_param = BT_LE_CONN_PARAM_DEFAULT};

//Sets up the callback function for when a connection is made, bt_connected function will be called on connection
static struct bt_conn_cb bluetooth_connection_cb = {.connected = bluetooth_le_connected};

static void bluetooth_le_connected(struct bt_conn *conn, uint8_t conn_err) {
	//TODO: Print device information what was just connected to
    if (conn_err) {
		LOG_ERR("Error with connecting to bluetooth le device, error code: %d", conn_err);
	}
	else {
		bluetooth_le_connection_set(conn);
		LOG_INF("Getting connection info...");
		const bt_addr_le_t *bluetooth_le_destination_address = bt_conn_get_dst(conn);
		LOG_HEXDUMP_INF(bluetooth_le_destination_address->a.val, BT_ADDR_SIZE, "Connected to: ");
	}
}

static void bluetooth_le_ready(int err) {
	LOG_INF("Bluetooth ready");

    //Registers callback for when their is a connection
	bt_conn_cb_register(&bluetooth_connection_cb);
}

static void bluetooth_le_scan_filter_match(struct bt_scan_device_info *device_info, struct bt_scan_filter_match *filter_match, bool connectable) {
	LOG_INF("Match found");
	bt_scan_stop();
}

void bluetooth_le_start_scan(const uint8_t *bluetooth_le_device_name) {
	int err;

	//Im pretty sure this creates a function called bluetooth_scan_cb and then registers the different callback for each scan.
	//As in either match, no_match, error or connection
	//Ive set it up to only do a callback if it finds a match, the other three are all null
	BT_SCAN_CB_INIT(bluetooth_scan_cb, bluetooth_le_scan_filter_match, NULL, NULL, NULL);
	bt_scan_cb_register(&bluetooth_scan_cb);

	//Sets the paramaters for scanning with bluetooth
	bt_scan_init(&bluetooth_initialisation_paramaters);

	//Enables scanning using the address filter
	err = bt_scan_filter_enable(BT_SCAN_NAME_FILTER, false);
	if (err) {
		LOG_ERR("Error with enabling filter, error code: %d", err);
	}
	else {
		LOG_INF("Filtering enabled successfully");
	}

	//Searches for a match to the address defined above
	err = bt_scan_filter_add(BT_SCAN_FILTER_TYPE_NAME, bluetooth_le_device_name);
	if (err) {
		LOG_ERR("Error with adding filter, error code: %d", err);
	}
	else {
		LOG_INF("Filter added successfully");
	}

	//Starts scanning actively
	err = bt_scan_start(BT_SCAN_TYPE_SCAN_ACTIVE);
	if (err) {
		LOG_ERR("Error with starting scanning, error code: %d", err);
	}
	else {
		LOG_INF("Scanning started successfully");
	}
}

void bluetooth_le_setup() {
    int err;

	err = bt_enable(bluetooth_le_ready);
	if (err) {
		LOG_ERR("Error with starting enabling of bluetooth, error code: %d", err);
	}
    else {
        LOG_INF("Bluetooth enabling started successfully");
    }
}
```

## src/bluetooth_le_scanning.h
```c
#ifndef BLUETOOTH_LE_SCANNING_H
#define BLUETOOTH_LE_SCANNING_H

#include "bluetooth_le_connection.h"

#include <zephyr/bluetooth/bluetooth.h>
#include <zephyr/bluetooth/conn.h>

//These are nrf header files
#include <bluetooth/scan.h>


// Paramaters taken from this example: https://developer.nordicsemi.com/nRF_Connect_SDK/doc/latest/nrf/samples/cellular/lte_ble_gateway/README.html
// https://developer.nordicsemi.com/nRF_Connect_SDK/doc/latest/zephyr/connectivity/bluetooth/api/gap.html#c.bt_le_scan_param
// static struct bt_le_scan_param bluetooth_scan_paramaters = {.type = BT_LE_SCAN_TYPE_ACTIVE,
//                                                      	   .options = BT_LE_SCAN_OPT_FILTER_DUPLICATE,
//                                                      	   .interval = 0x0010,
//                                                      	   .window = 0x0010};

// Paramaters taken from this example: https://developer.nordicsemi.com/nRF_Connect_SDK/doc/latest/nrf/samples/cellular/lte_ble_gateway/README.html
// https://developer.nordicsemi.com/nRF_Connect_SDK/doc/latest/nrf/libraries/bluetooth_services/scan.html#c.bt_scan_init_param
// static struct bt_scan_init_param bluetooth_initialisation_paramaters = {.connect_if_match = true,
// 																 		   .scan_param = &bluetooth_scan_paramaters,
//                                                                  	   .conn_param = BT_LE_CONN_PARAM_DEFAULT};

//Sets up the callback function for when a connection is made, bt_connected function will be called on connection
// static struct bt_conn_cb bluetooth_connection_cb = {.connected = bluetooth_le_connected};

//Function called on bluetooth connection
//static void bluetooth_le_connected(struct bt_conn *conn, uint8_t conn_err);

//Function that is called when bluetooth is ready
// static void bluetooth_le_ready(int err);

//Callback for when a bluetooth device matches the filters and then stops the bluetooth scanning
// static void bluetooth_le_scan_filter_match(struct bt_scan_device_info *device_info, struct bt_scan_filter_match *filter_match, bool connectable);

//Sets up callbacks for scan, enables filter, sets filters and starts scanning
void bluetooth_le_start_scan(const uint8_t *bluetooth_le_device_name);

void bluetooth_le_setup();

void bluetooth_le_gatt_print_services();

#endif 
```
